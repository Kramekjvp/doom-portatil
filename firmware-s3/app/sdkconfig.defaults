## firmware-s3/components/doom_game/Kconfig
```kconfig
menu "Doom (doomgeneric)"

    config DOOM_STRETCH_4_3
        bool "Esticar 320x200 para 320x240 (4:3 como no VGA original)"
        default y
        help
            O Doom desenha 320x200 com pixels nao quadrados (4:3 na tela do PC).
            Ligado: repete 1 linha a cada 5 e preenche o painel 320x240 inteiro.
            Desligado: imagem 320x200 centralizada, com 20 linhas pretas em cima e embaixo.

    config DOOM_ALWAYS_RUN
        bool "Correr sempre (sem botao de corrida)"
        default y
        help
            O console tem so 8 botoes; sem isso o Doom andaria devagar.

    config DOOM_ZONE_MB
        int "Memoria do Doom (zona), em MiB"
        range 4 7
        default 6
        help
            Fica na PSRAM (8 MB no N16R8). O doomgeneric usa 6 por padrao.
            O shareware roda com menos; sobra PSRAM para o resto do sistema.

    config DOOM_WAD_PARTITION
        string "Nome da particao de dados com o WAD"
        default "wad"
        help
            Tipo data, subtipo 0x40 (ver partitions.csv do exemplo).
            Gravar: python -m esptool ... write_flash <offset> doom1.wad
            (o README do exemplo tem o comando pronto).

endmenu
```

## firmware-s3/components/input_gpio/Kconfig
```kconfig
menu "Entrada: botoes em GPIO direto"

    comment "Cada botao liga o GPIO ao GND (usa pull-up interno). -1 = botao ausente."
    comment "Pinos propostos evitam os da tela (4-10, 14-18, 21) e os reservados do S3 N16R8."

    config INPUT_GPIO_UP
        int "GPIO do botao CIMA"
        range -1 48
        default -1

    config INPUT_GPIO_DOWN
        int "GPIO do botao BAIXO"
        range -1 48
        default 1

    config INPUT_GPIO_LEFT
        int "GPIO do botao ESQUERDA"
        range -1 48
        default 2

    config INPUT_GPIO_RIGHT
        int "GPIO do botao DIREITA"
        range -1 48
        default 42

    config INPUT_GPIO_A
        int "GPIO do botao A (girar no Tetris)"
        range -1 48
        default 41

    config INPUT_GPIO_B
        int "GPIO do botao B (queda no Tetris)"
        range -1 48
        default 40

    config INPUT_GPIO_START
        int "GPIO do botao START (pausa no Tetris)"
        range -1 48
        default 39

    config INPUT_GPIO_SELECT
        int "GPIO do botao SELECT (sair para o launcher)"
        range -1 48
        default -1

endmenu
```

## firmware-s3/components/lcd_i80/Kconfig
```kconfig
menu "LCD i80 (ILI9341 paralelo 8 bits)"

    comment "Pinos PROPOSTOS: evitam 0,3,19,20 (strapping/USB), 26-37 (flash/PSRAM octal), 43,44 (UART0), 45,46."
    comment "A ordem D0..D7 e livre: o i80 do ESP32-S3 roteia qualquer GPIO. Ajuste ao que voce ligar de fato."

    config LCD_I80_PIN_D0
        int "GPIO de LCD_D0"
        range 0 48
        default 4

    config LCD_I80_PIN_D1
        int "GPIO de LCD_D1"
        range 0 48
        default 5

    config LCD_I80_PIN_D2
        int "GPIO de LCD_D2"
        range 0 48
        default 6

    config LCD_I80_PIN_D3
        int "GPIO de LCD_D3"
        range 0 48
        default 7

    config LCD_I80_PIN_D4
        int "GPIO de LCD_D4"
        range 0 48
        default 15

    config LCD_I80_PIN_D5
        int "GPIO de LCD_D5"
        range 0 48
        default 16

    config LCD_I80_PIN_D6
        int "GPIO de LCD_D6"
        range 0 48
        default 17

    config LCD_I80_PIN_D7
        int "GPIO de LCD_D7"
        range 0 48
        default 18

    config LCD_I80_PIN_WR
        int "GPIO de LCD_WR (clock de escrita)"
        range 0 48
        default 8

    config LCD_I80_PIN_DC
        int "GPIO de LCD_RS (dado/comando)"
        range 0 48
        default 9

    config LCD_I80_PIN_CS
        int "GPIO de LCD_CS"
        range 0 48
        default 10

    config LCD_I80_PIN_RST
        int "GPIO de LCD_RST (-1 = ligado ao reset da placa)"
        range -1 48
        default 14

    config LCD_I80_PIN_RD
        int "GPIO de LCD_RD (mantido em nivel alto; -1 = ligado direto em 3V3)"
        range -1 48
        default 21

    config LCD_I80_PCLK_HZ
        int "Clock de escrita (Hz)"
        range 1000000 20000000
        default 10000000
        help
            O ILI9341 aceita ~15 MHz em escrita. Em protoboard com jumpers,
            comece em 10 MHz; se estiver estavel, tente 15 MHz.

    config LCD_I80_MADCTL
        hex "Registrador MADCTL (orientacao e ordem de cor)"
        default 0x48
        help
            0x48 = retrato, BGR (padrao do TFT_eSPI, rotacao 0).
            Se a imagem sair espelhada, tente 0x08, 0x88 ou 0xC8.
            Se vermelho e azul estiverem trocados, alterne o bit 0x08.

    config LCD_I80_INVERT
        bool "Inverter cores (comando INVON)"
        default n
        help
            Alguns paineis/shields precisam de INVON para cores corretas.

endmenu
```

## firmware-s3/examples/doom_standalone/main/Kconfig.projbuild
```kconfig
menu "Doom standalone"
    config DOOM_STANDALONE_TELA_DE_TESTE
        bool "Mostrar barras R/G/B por 2,5 s antes do Doom"
        default y
endmenu
```

## firmware/components/lcd_spi/Kconfig
```kconfig
menu "LCD SPI (ILI9341 modulo 2,8 pol)"

    comment "Pinos PROPOSTOS: CS/MOSI/SCK sao os pinos nativos do SPI2 (FSPI) do ESP32-S3 e aguentam velocidades altas."
    comment "Evite 0,3,19,20 (strapping/USB), 26-37 (flash/PSRAM octal), 43,44 (UART0), 45,46."

    config LCD_SPI_PIN_CS
        int "GPIO de CS"
        range 0 48
        default 10

    config LCD_SPI_PIN_MOSI
        int "GPIO de SDI (MOSI)"
        range 0 48
        default 11

    config LCD_SPI_PIN_SCLK
        int "GPIO de SCK"
        range 0 48
        default 12

    config LCD_SPI_PIN_DC
        int "GPIO de DC (dado/comando)"
        range 0 48
        default 9

    config LCD_SPI_PIN_RST
        int "GPIO de RESET (-1 = ligado ao reset da placa)"
        range -1 48
        default 14

    config LCD_SPI_PIN_BL
        int "GPIO do backlight / pino LED (-1 = ligado direto em 3V3)"
        range -1 48
        default -1

    config LCD_SPI_CLK_HZ
        int "Clock do SPI (Hz)"
        range 1000000 80000000
        default 20000000
        help
            Comece em 20 MHz (jumpers longos ou protoboard); se a imagem estiver
            estavel, suba para 40 MHz. Teto de quadros por segundo com o quadro
            inteiro (~154 KB): ~16 fps a 20 MHz, ~32 fps a 40 MHz, ~64 fps a 80 MHz.

    config LCD_SPI_MADCTL
        hex "Registrador MADCTL (orientacao e ordem de cor)"
        default 0x48
        help
            0x48 = retrato, BGR (padrao do TFT_eSPI, rotacao 0).
            Se a imagem sair espelhada, tente 0x08, 0x88 ou 0xC8.
            Se vermelho e azul estiverem trocados, alterne o bit 0x08.

    config LCD_SPI_MADCTL_LANDSCAPE
        hex "MADCTL em paisagem (Doom, 320x240)"
        default 0x28
        help
            0x28 = paisagem BGR (TFT_eSPI rotacao 1; par do 0x48 do retrato).
            Se a imagem sair de cabeca para baixo, tente 0xE8.
            Se sair espelhada, tente 0x68 ou 0xA8.

    config LCD_SPI_INVERT
        bool "Inverter cores (comando INVON)"
        default n
        help
            Alguns paineis precisam de INVON para cores corretas.
            Se tudo sair com cores invertidas (branco no lugar de preto), ligue esta opcao.

endmenu
```

## firmware/main/Kconfig.projbuild
```kconfig
menu "Portatil (firmware unico)"

    choice PORTATIL_TELA
        prompt "Tela do console"
        default PORTATIL_TELA_SPI
        help
            Escolhe qual driver define as funcoes de desenho (gfx_*). So um dos dois
            existe no firmware. Mudou a escolha? Rode idf.py reconfigure e compile de novo.

        config PORTATIL_TELA_SPI
            bool "Modulo ILI9341 SPI 2,8 pol (ADR-0013)"

        config PORTATIL_TELA_I80
            bool "Shield ILI9341 paralelo 8 bits (ADR-0008)"
    endchoice

    config PORTATIL_TELA_DE_TESTE
        bool "Mostrar barras R/G/B por 2,5 s ao ligar (confere fiacao, cor e orientacao)"
        default y
endmenu
```
